## conf/layer.conf
```bitbake
# We have a conf and classes directory, add to BBPATH
BBPATH .= ":${LAYERDIR}"

# We have recipes-* directories, add to BBFILES
BBFILES += "${LAYERDIR}/recipes-*/*/*.bb \
            ${LAYERDIR}/recipes-*/*/*.bbappend"

BBFILE_COLLECTIONS += "meta-rpi-helper"
BBFILE_PATTERN_meta-rpi-helper = "^${LAYERDIR}/"
BBFILE_PRIORITY_meta-rpi-helper = "6"

LAYERDEPENDS_meta-rpi-helper = "core"
LAYERSERIES_COMPAT_meta-rpi-helper = "whinlatter"

CORE_IMAGE_EXTRA_INSTALL:append = " usbutils pciutils coreutils nfs-utils "
CORE_IMAGE_EXTRA_INSTALL:append = " kernel-modules "
CORE_IMAGE_EXTRA_INSTALL:append = " rpi4-vl805-rootfs-addon "
CORE_IMAGE_EXTRA_INSTALL:append = " iperf3 "

# KERNEL_CLASSES += "fitimage"
# KERNEL_IMAGETYPE = "fitImage"
# KERNEL_FITCONFIG = "conf@conf-bcm2711-rpi-cm4.dtb"
# bitbake -k linux-yocto-fitimage
# mkimage -f fit-image.its fitImage
# Add ramdisk: apply <layer-dir>/meta-rpi-helper/conf/files/fit-image.its.patch

# Initramfs support
# INITRAMFS_IMAGE = "core-image-minimal-initramfs"
# INITRAMFS_FSTYPES = "cpio.gz"
# INITRAMFS_IMAGE_BUNDLE = "1"

# Allows root to login without a password
# Automatically logs in as root on the serial console
IMAGE_FEATURES:append = " empty-root-password "
IMAGE_FEATURES:append = " serial-autologin-root "
```
